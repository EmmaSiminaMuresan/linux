// SPDX-License-Identifier: GPL-2.0
#include "zynq-zybo-z7.dts"

/ {
	spi_adi_ad5592r@0 {
		compatible = "adi,spi-adi-emu";
		#address-cells = <1>;
		#size-cells = <0>;

		IIO_ADI_AD5592R@0 {
			compatible = "iio-adi-emu";
			reg = <0>;
			spi-max-frequency = <1000000>;
		};
	};
};