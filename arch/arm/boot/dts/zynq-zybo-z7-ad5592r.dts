// SPDX-License-Identifier: GPL-2.0+
/dts-v1/;
#include "zynq-zybo-z7.dts"

&spi0{
        status = "okay";
    
    ad5592r@0 {
        compatible = "ad5592rs";
        reg = <0>;
        spi-max-frequency = <10000000>;
    };
};
